## defconfig
```kconfig
CONFIG_BOOTLOADER_COMPILER_OPTIMIZATION_PERF=y
CONFIG_BOOTLOADER_LOG_COLORS=y
CONFIG_APP_RETRIEVE_LEN_ELF_SHA=16
CONFIG_ESPTOOLPY_FLASHFREQ_20M=y
CONFIG_ESPTOOLPY_HEADER_FLASHSIZE_UPDATE=y
CONFIG_COMPILER_OPTIMIZATION_PERF=y
CONFIG_BT_ENABLED=y
CONFIG_BT_NIMBLE_ENABLED=y
CONFIG_PM_ENABLE=y
CONFIG_PM_DFS_INIT_AUTO=y
CONFIG_PM_POWER_DOWN_PERIPHERAL_IN_LIGHT_SLEEP=y
CONFIG_ESP_DEFAULT_CPU_FREQ_MHZ_80=y
CONFIG_LOG_VERSION_2=y
CONFIG_LOG_COLORS=y
CONFIG_LWIP_TCP_SND_BUF_DEFAULT=5744
CONFIG_LWIP_TCP_WND_DEFAULT=5744
CONFIG_LWIP_HOOK_IP6_INPUT_NONE=y
```

## main/Kconfig.projbuild
```kconfig
menu "PrincessPiTracker Config"
    config ADVERTISEMENT_INTERVAL
        int "Interval between advertisements in milliseconds"
        default 100
        range 12 10240
        help
            Int number of milliseconds (ms) in between advertisements min 12 max 10240
            100 for max delay with 10ms random
            200 for deep sleep burst mode

    config ADVERTISEMENT_INTERVAL_JITTER_MS
        int "Max Jitter to add to Advertisement Interval in milliseconds"
        default 10
        range 0 500
        help
            Int number of milliseconds (ms) max jitter to add to advertisement interval min 0 max 2000
    
    config ADVERTISEMENT_KEY
        string "Your Advertisement Key"
        default ""
        help
           Your advertisement key, see https://github.com/leonboe1/GoogleFindMyTools

    config DISABLE_USB_WHILE_CHARGING
        bool "Disable USB Serial and Broadcasting While Charging"
        default y
        help
           Enable this option to disable USB Serial and Broadcasting while charging to save power.
           
    config DEVICE_NAME
        string "BLE Device Name"
        default "PrincesiPiTracker"
        help
           The Bluetooth device name that will be broadcasted.

    config TAG
        string "Logging Tag"
        default "PrincessPiTracker"
        help
           The tag used in logging messages.

    config RANDOM_MAC_ADDRESS
        bool "Use Random MAC Address"
        default n
        help
           Enable this option to use a random MAC address for BLE advertising instead of the public MAC address.
    
    config DEEP_SLEEP_BURST_MODE
        bool "Enable Deep Sleep Burst Mode"
        default y
        help
           Enable this option to wake up, send multiple advertisements in a burst, then go back to deep sleep.

    config DEEP_SLEEP_BURST_COUNT
        int "Number of Advertisements per Burst"
        default 4
        range 1 100
        depends on DEEP_SLEEP_BURST_MODE
        help
            Int number of advertisements to send per burst min 1 max 100

    config DEEP_SLEEP_DURATION_S
        int "Deep Sleep Duration in seconds"
        default 120
        range 0 86400
        depends on DEEP_SLEEP_BURST_MODE
        help
            Int number of seconds (s) to deep sleep between advertisement cycles min 0 max 86400 (24 hours)
    
    config STARTUP_DELAY_MS
        int "Startup Delay in milliseconds"
        default 1000
        range 0 60000
        help
            Int number of milliseconds (ms) to delay startup to allow peripherals to initialize min 0 max 60000
endmenu
```

## sdkconfig.defaults
```kconfig
# manuallyc created
CONFIG_BT_ENABLED=y
CONFIG_BOOTLOADER_COMPILER_OPTIMIZATION_PERF=y
CONFIG_BOOTLOADER_LOG_COLORS=y
CONFIG_APP_RETRIEVE_LEN_ELF_SHA=16
CONFIG_ESPTOOLPY_HEADER_FLASHSIZE_UPDATE=y
CONFIG_COMPILER_OPTIMIZATION_PERF=y
CONFIG_PM_ENABLE=y
CONFIG_PM_DFS_INIT_AUTO=y
CONFIG_PM_POWER_DOWN_PERIPHERAL_IN_LIGHT_SLEEP=y
CONFIG_LOG_VERSION_2=y
CONFIG_LOG_COLORS=y
```

## sdkconfig.defaults.esp32
```kconfig
# manually created
# bootloader too big for sum fuckin reason on esp32 only so now we optimize this one alone for space and not size
## gotta disable the performance one and enable da size one for safety
CONFIG_BOOTLOADER_COMPILER_OPTIMIZATION_PERF=n
CONFIG_BOOTLOADER_COMPILER_OPTIMIZATION_SIZE=y

CONFIG_ESPTOOLPY_FLASHFREQ_20M=y
CONFIG_ESPTOOLPY_HEADER_FLASHSIZE_UPDATE=y
CONFIG_BT_BTU_TASK_STACK_SIZE=4096
CONFIG_ESP_DEFAULT_CPU_FREQ_MHZ_80=y
CONFIG_LWIP_TCP_SND_BUF_DEFAULT=5744
CONFIG_LWIP_TCP_WND_DEFAULT=5744
CONFIG_LWIP_HOOK_IP6_INPUT_NONE=y
```

## sdkconfig.defaults.esp32c3
```kconfig
# manually created
CONFIG_BT_NIMBLE_ENABLED=y
CONFIG_ESP_DEFAULT_CPU_FREQ_MHZ_80=y
```

## sdkconfig.defaults.esp32c6
```kconfig
# manually created
CONFIG_BT_NIMBLE_ENABLED=y
CONFIG_ESP_DEFAULT_CPU_FREQ_MHZ_80=y
CONFIG_LWIP_TCP_SND_BUF_DEFAULT=5744
CONFIG_LWIP_TCP_WND_DEFAULT=5744
CONFIG_LWIP_HOOK_IP6_INPUT_NONE=y
CONFIG_MBEDTLS_SSL_KEEP_PEER_CERTIFICATE=y
CONFIG_VFS_SUPPORT_TERMIOS=y
```

## sdkconfig.defaults.esp32s3
```kconfig
# manually created
CONFIG_BT_NIMBLE_ENABLED=y
CONFIG_ESPTOOLPY_FLASHFREQ_20M=y
CONFIG_BT_BTU_TASK_STACK_SIZE=4096
CONFIG_ESP_DEFAULT_CPU_FREQ_MHZ_80=y
CONFIG_LWIP_TCP_SND_BUF_DEFAULT=5744
CONFIG_LWIP_TCP_WND_DEFAULT=5744
CONFIG_LWIP_HOOK_IP6_INPUT_NONE=y
CONFIG_MBEDTLS_SSL_KEEP_PEER_CERTIFICATE=y
CONFIG_VFS_SUPPORT_TERMIOS=y
```
